## firmware/sdkconfig.defaults
```kconfig
# ═════════════════════════════════════════════════════════════════════════════
# Parakram Universal Factory Firmware — SDK Configuration
# Target: ESP32-S3-WROOM-1 · N16R8 (16 MB flash · 8 MB OPI PSRAM)
# Board:  Vidyuthlabs S3-PRO
# Cert:   Secure Boot v2, Flash Encryption, DO-178C / MISRA C ready
# ═════════════════════════════════════════════════════════════════════════════

# ─── Target ──────────────────────────────────────────────────────────────────
CONFIG_IDF_TARGET="esp32s3"
CONFIG_FREERTOS_HZ=1000

# ─── Flash (16 MB QIO 80 MHz) ───────────────────────────────────────────────
CONFIG_ESPTOOLPY_FLASHSIZE_16MB=y
CONFIG_ESPTOOLPY_FLASHSIZE="16MB"
CONFIG_ESPTOOLPY_FLASHMODE_QIO=y
CONFIG_ESPTOOLPY_FLASHFREQ_80M=y

# ─── Partition table ─────────────────────────────────────────────────────────
CONFIG_PARTITION_TABLE_CUSTOM=y
CONFIG_PARTITION_TABLE_CUSTOM_FILENAME="partitions.csv"
CONFIG_PARTITION_TABLE_OFFSET=0x8000

# ─── PSRAM — 8 MB OPI (Octal SPI, 80 MHz) ──────────────────────────────────
CONFIG_ESP32S3_SPIRAM_SUPPORT=y
CONFIG_SPIRAM_MODE_OCT=y
CONFIG_SPIRAM_SPEED_80M=y
CONFIG_SPIRAM_SIZE=8388608
CONFIG_SPIRAM_USE_MALLOC=y
CONFIG_SPIRAM_MALLOC_ALWAYSINTERNAL=4096
CONFIG_SPIRAM_ALLOW_BSS_SEG_EXTERNAL_MEMORY=y
CONFIG_SPIRAM_MALLOC_RESERVE_INTERNAL=65536

# ─── SD Card (SDMMC, native 4-bit) ──────────────────────────────────────────
CONFIG_SOC_SDMMC_HOST_SUPPORTED=y
CONFIG_SOC_SDMMC_USE_GPIO_MATRIX=y

# ─── WiFi ────────────────────────────────────────────────────────────────────
CONFIG_ESP_WIFI_STATIC_RX_BUFFER_NUM=8
CONFIG_ESP_WIFI_DYNAMIC_RX_BUFFER_NUM=16
CONFIG_ESP_WIFI_DYNAMIC_TX_BUFFER=y
CONFIG_ESP_WIFI_DYNAMIC_TX_BUFFER_NUM=16
CONFIG_ESP_WIFI_NVS_ENABLED=y
CONFIG_ESP_WIFI_RX_BA_WIN=8

# ─── Bluetooth (NimBLE — smaller footprint, S3-optimized) ───────────────────
CONFIG_BT_ENABLED=y
CONFIG_BT_NIMBLE_ENABLED=y
CONFIG_BT_NIMBLE_MAX_CONNECTIONS=1
CONFIG_BT_NIMBLE_ROLE_CENTRAL=n
CONFIG_BT_NIMBLE_ROLE_OBSERVER=n
CONFIG_BT_NIMBLE_50_FEATURE_SUPPORT=n

# ─── OTA (dual partition, automatic rollback) ───────────────────────────────
CONFIG_BOOTLOADER_APP_ROLLBACK_ENABLE=y
CONFIG_BOOTLOADER_APP_ANTI_ROLLBACK=y
CONFIG_BOOTLOADER_APP_SECURE_VERSION=1

# ─── Secure Boot v2 (RSA-PSS, production boards) ────────────────────────────
# NOTE: Uncomment these for production eFuse-burned boards.
# Once enabled, ONLY signed firmware can run. This is IRREVERSIBLE.
# CONFIG_SECURE_BOOT=y
# CONFIG_SECURE_BOOT_V2_ENABLED=y
# CONFIG_SECURE_SIGNED_APPS_RSA_SCHEME=y
# CONFIG_SECURE_BOOT_SIGNING_KEY="secure_boot_signing_key.pem"

# ─── Flash Encryption (AES-256-XTS, production boards) ──────────────────────
# NOTE: Uncomment for production. IRREVERSIBLE after first boot.
# CONFIG_SECURE_FLASH_ENC_ENABLED=y
# CONFIG_SECURE_FLASH_ENCRYPTION_MODE_RELEASE=y

# ─── mbedTLS (hardware accelerated + PSA Crypto for Ed25519) ────────────────
CONFIG_MBEDTLS_HARDWARE_AES=y
CONFIG_MBEDTLS_HARDWARE_SHA=y
CONFIG_MBEDTLS_PSA_CRYPTO_C=y
CONFIG_MBEDTLS_EDDSA_C=y
CONFIG_MBEDTLS_ECP_C=y
CONFIG_MBEDTLS_ECP_DP_CURVE25519_ENABLED=y
CONFIG_MBEDTLS_HARDWARE_GCM=y
CONFIG_MBEDTLS_SSL_MAX_CONTENT_LEN=16384

# ─── Watchdog (hardware, panic on timeout) ──────────────────────────────────
CONFIG_ESP_TASK_WDT_EN=y
CONFIG_ESP_TASK_WDT_TIMEOUT_S=10
CONFIG_ESP_TASK_WDT_PANIC=y
CONFIG_ESP_INT_WDT=y
CONFIG_ESP_INT_WDT_TIMEOUT_MS=300

# ─── Brown-out detection ────────────────────────────────────────────────────
CONFIG_ESP_BROWNOUT_DET=y
CONFIG_ESP_BROWNOUT_DET_LVL_SEL_7=y

# ─── Stack overflow detection ───────────────────────────────────────────────
CONFIG_FREERTOS_CHECK_STACKOVERFLOW_CANARY=y

# ─── Stack sizes ─────────────────────────────────────────────────────────────
CONFIG_ESP_MAIN_TASK_STACK_SIZE=8192
CONFIG_FREERTOS_IDLE_TASK_STACKSIZE=2048
CONFIG_ESP_SYSTEM_EVENT_TASK_STACK_SIZE=4096

# ─── FreeRTOS hardening ─────────────────────────────────────────────────────
CONFIG_FREERTOS_ASSERT_ON_UNTESTED_FUNCTION=y
CONFIG_FREERTOS_TASK_FUNCTION_WRAPPER=y
CONFIG_FREERTOS_USE_TRACE_FACILITY=y
CONFIG_FREERTOS_GENERATE_RUN_TIME_STATS=y

# ─── Core dump (flash, for post-mortem analysis) ────────────────────────────
CONFIG_ESP_COREDUMP_ENABLE_TO_FLASH=y
CONFIG_ESP_COREDUMP_DATA_FORMAT_ELF=y
CONFIG_ESP_COREDUMP_MAX_TASKS_NUM=16

# ─── Compiler hardening ─────────────────────────────────────────────────────
CONFIG_COMPILER_STACK_CHECK_MODE_STRONG=y
CONFIG_COMPILER_STACK_CHECK=y
CONFIG_COMPILER_WARN_WRITE_STRINGS=y
CONFIG_COMPILER_OPTIMIZATION_PERF=y

# ─── Logging ─────────────────────────────────────────────────────────────────
CONFIG_LOG_DEFAULT_LEVEL_INFO=y
CONFIG_LOG_MAXIMUM_LEVEL_VERBOSE=y

# ─── System ──────────────────────────────────────────────────────────────────
CONFIG_ESP_SYSTEM_PANIC_PRINT_REBOOT=y
CONFIG_ESP_SYSTEM_SINGLE_CORE_MODE=n
CONFIG_ESP_TIMER_TASK_STACK_SIZE=4096

# ─── eFuse (board identity, read-only after factory burn) ───────────────────
CONFIG_EFUSE_VIRTUAL=y
CONFIG_EFUSE_VIRTUAL_KEEP_IN_FLASH=y

# ─── LVGL (minimal memory, phone renders via DumbDisplay) ───────────────────
CONFIG_LV_MEM_CUSTOM=y
CONFIG_LV_MEM_SIZE_KILOBYTES=32
CONFIG_LV_DISP_DEF_REFR_PERIOD=30
CONFIG_LV_FONT_MONTSERRAT_14=y
CONFIG_LV_FONT_MONTSERRAT_8=n
CONFIG_LV_FONT_MONTSERRAT_10=n
CONFIG_LV_FONT_MONTSERRAT_12=n
CONFIG_LV_FONT_MONTSERRAT_16=n
CONFIG_LV_FONT_MONTSERRAT_18=n
CONFIG_LV_FONT_MONTSERRAT_20=n
CONFIG_LV_FONT_MONTSERRAT_22=n
CONFIG_LV_FONT_MONTSERRAT_24=n
CONFIG_LV_FONT_MONTSERRAT_26=n
CONFIG_LV_FONT_MONTSERRAT_28=n
CONFIG_LV_FONT_MONTSERRAT_30=n
CONFIG_LV_FONT_MONTSERRAT_32=n
CONFIG_LV_FONT_MONTSERRAT_34=n
CONFIG_LV_FONT_MONTSERRAT_36=n
CONFIG_LV_FONT_MONTSERRAT_38=n
CONFIG_LV_FONT_MONTSERRAT_40=n
CONFIG_LV_FONT_MONTSERRAT_42=n
CONFIG_LV_FONT_MONTSERRAT_44=n
CONFIG_LV_FONT_MONTSERRAT_46=n
CONFIG_LV_FONT_MONTSERRAT_48=n
CONFIG_LV_USE_BIDI=n
CONFIG_LV_USE_ARABIC_PERSIAN_CHARS=n
CONFIG_LV_USE_LOG=n
CONFIG_LV_BUILD_EXAMPLES=n
CONFIG_LV_USE_DEMO_WIDGETS=n
CONFIG_LV_USE_DEMO_KEYPAD_AND_ENCODER=n
CONFIG_LV_USE_DEMO_BENCHMARK=n
CONFIG_LV_USE_DEMO_STRESS=n
CONFIG_LV_USE_DEMO_MUSIC=n

# ─── PSRAM allocation strategy ─────────────────────────────────────────────
# Move WiFi/BLE RX buffers and large BSS to PSRAM
CONFIG_ESP_WIFI_CACHE_TX_BUF_NUM=16
CONFIG_SPIRAM_TRY_ALLOCATE_WIFI_LWIP=y
CONFIG_BT_NIMBLE_MEM_ALLOC_MODE_EXTERNAL=y

# ─── Development mode flag ──────────────────────────────────────────────────
# Set PARAKRAM_DEV_MODE=1 in CMakeLists.txt for dev boards.
# Production boards: PARAKRAM_DEV_MODE=0 (enforces board auth + secure boot).
```

## firmware/sdkconfig.defaults.qemu
```kconfig
# QEMU Simulation Build Defaults
# Usage: idf.py -D SDKCONFIG_DEFAULTS="sdkconfig.defaults.qemu" build
#
# Disables PSRAM (not emulated in QEMU) and BT (causes assertion in QEMU).
# Core firmware (VM, drivers, scheduler, event bus) works fully.
# WiFi init starts but stalls at PHY calibration (expected — no radio in QEMU).

CONFIG_SPIRAM=n
CONFIG_BT_ENABLED=n
```
